## CMakeLists.txt
```
cmake_minimum_required(VERSION 3.20.0)
find_package(Zephyr REQUIRED HINTS $ENV{ZEPHYR_BASE})
project(n900_phone)

# Camera sensor register lists are generated from a local Linux tree at build time
set(LINUX_DIR $ENV{HOME}/linux CACHE PATH "Linux source tree with the et8ek8 driver")
set(ET8EK8_MODES ${LINUX_DIR}/drivers/media/i2c/et8ek8/et8ek8_mode.c)
set(GEN_DIR ${CMAKE_CURRENT_BINARY_DIR}/gen)
add_custom_command(
  OUTPUT ${GEN_DIR}/et8ek8_regs.h
  COMMAND ${PYTHON_EXECUTABLE} ${CMAKE_CURRENT_SOURCE_DIR}/gen_regs.py
          ${ET8EK8_MODES} ${GEN_DIR}/et8ek8_regs.h
  DEPENDS ${CMAKE_CURRENT_SOURCE_DIR}/gen_regs.py ${ET8EK8_MODES}
)
add_custom_target(et8ek8_regs DEPENDS ${GEN_DIR}/et8ek8_regs.h)
add_dependencies(app et8ek8_regs)
target_include_directories(app PRIVATE ${GEN_DIR})
# Zephyr kite images from the documentation artwork
set(KITE_PNG $ENV{ZEPHYR_BASE}/doc/_static/images/kite.png)
add_custom_command(
  OUTPUT ${GEN_DIR}/kites.c ${GEN_DIR}/kites.h
  COMMAND ${PYTHON_EXECUTABLE} ${CMAKE_CURRENT_SOURCE_DIR}/gen_kites.py
          ${KITE_PNG} ${GEN_DIR}/kites.c ${GEN_DIR}/kites.h
  DEPENDS ${CMAKE_CURRENT_SOURCE_DIR}/gen_kites.py ${KITE_PNG}
)
add_custom_target(kites DEPENDS ${GEN_DIR}/kites.c ${GEN_DIR}/kites.h)
add_dependencies(app kites)
target_sources(app PRIVATE src/hw.c src/ui.c src/camera.c src/sound.c ${GEN_DIR}/kites.c)
target_sources_ifdef(CONFIG_BT app PRIVATE src/btui.c)
# The terminal: the shell backend, its character grid and its font (see gen_font.py)
target_sources(app PRIVATE src/shell_term.c src/term.c src/font_adwaita_mono_14.c)
```

## prj.conf
```kconfig
CONFIG_MAIN_STACK_SIZE=16384
CONFIG_SYSTEM_WORKQUEUE_STACK_SIZE=4096
CONFIG_INPUT=y
CONFIG_DISPLAY=y
CONFIG_SENSOR=y
CONFIG_LED=y

CONFIG_LVGL=y
CONFIG_LV_Z_MEM_POOL_SIZE=4194304
CONFIG_LV_Z_VDB_SIZE=25
CONFIG_LV_FONT_MONTSERRAT_14=y
CONFIG_LV_FONT_MONTSERRAT_20=y
CONFIG_LV_FONT_MONTSERRAT_28=y
CONFIG_LV_FONT_MONTSERRAT_48=y
CONFIG_LV_FONT_DEFAULT_MONTSERRAT_20=y
CONFIG_LV_USE_LOG=n
CONFIG_LV_Z_SW_ROTATION=y
CONFIG_GPIO=y
CONFIG_I2C=y
CONFIG_CACHE_MANAGEMENT=y
CONFIG_KERNEL_VM_SIZE=0x2000000
CONFIG_HAPTICS=y
CONFIG_I2S=y
CONFIG_AUDIO=y
CONFIG_AUDIO_CODEC=y

# The Terminal app: a shell on the screen, with the log
CONFIG_SHELL=y
CONFIG_SHELL_STACK_SIZE=4096
CONFIG_SHELL_DEFAULT_TERMINAL_WIDTH=88
CONFIG_SHELL_DEFAULT_TERMINAL_HEIGHT=23
CONFIG_LOG=y
CONFIG_GPIO_SHELL=y
CONFIG_I2C_SHELL=y
CONFIG_SENSOR_SHELL=y
```

## overlay-bt.conf
```kconfig
# SPDX-FileCopyrightText: Copyright (c) 2026 Silicon Laboratories Inc.
# SPDX-License-Identifier: Apache-2.0

# Bluetooth BR/EDR for the phone demo: build with -DEXTRA_CONF_FILE=overlay-bt.conf and
# CONFIG_BT_NOKIA_H4P_FIRMWARE set to the BCM2048 firmware script (see the board docs)
CONFIG_BT=y
CONFIG_BT_CLASSIC=y
CONFIG_BT_DEVICE_NAME="N900"
CONFIG_BT_DEVICE_NAME_DYNAMIC=y
CONFIG_BT_DEVICE_NAME_MAX=31
# Major class Phone, minor class Smartphone
CONFIG_BT_COD=0x00020C
CONFIG_BT_MAX_CONN=4
CONFIG_BT_MAX_PAIRED=8
# The Bluetooth address is derived from the device ID
CONFIG_HWINFO=y
```

## src/btui.c
```c
/*
 * SPDX-FileCopyrightText: Copyright (c) 2026 Silicon Laboratories Inc.
 * SPDX-License-Identifier: Apache-2.0
 */

/*
 * N900 phone demo: Bluetooth BR/EDR side. Host callbacks run in Bluetooth
 * threads: they update the state below under the lock and post PEV_BT events,
 * and the UI reads snapshots of the state in the LVGL thread.
 */
#include <errno.h>
#include <stdio.h>
#include <string.h>

#include <zephyr/bluetooth/bluetooth.h>
#include <zephyr/bluetooth/classic/classic.h>
#include <zephyr/bluetooth/conn.h>
#include <zephyr/drivers/hwinfo.h>
#include <zephyr/kernel.h>
#include <zephyr/logging/log.h>
#include <zephyr/sys/byteorder.h>

#include "btui.h"
#include "phone.h"

LOG_MODULE_REGISTER(btui, LOG_LEVEL_INF);

/* Inquiry length in units of 1.28 s */
#define DISCOVERY_LENGTH 8

enum auth_kind {
	AUTH_NONE,
	AUTH_DISPLAY,
	AUTH_PASSKEY_CONFIRM,
	AUTH_PAIRING_CONFIRM,
};

static K_MUTEX_DEFINE(lock);
static struct btui_info info;
static struct btui_device devices[BTUI_MAX_DEVICES];
static size_t device_count;
static struct bt_br_discovery_result results[BTUI_MAX_DEVICES];

/* Outgoing pairing: the connection is secured once it is up */
static struct bt_conn *pair_conn;
/* Pairing request waiting for the user's answer */
static struct bt_conn *auth_conn;
static enum auth_kind auth_kind;

static void post(enum btui_event ev, int32_t value)
{
	phone_post(PEV_BT, ev, value);
}

/* Name from Extended Inquiry Response data, empty if it has none */
static void eir_name(const uint8_t *eir, size_t len, char *name, size_t size)
{
	size_t i = 0;

	name[0] = '\0';
	while ((i + 1U < len) && (eir[i] != 0U) && (i + 1U + eir[i] <= len)) {
		uint8_t field = eir[i];
		uint8_t type = eir[i + 1U];

		if ((type == BT_DATA_NAME_COMPLETE) || (type == BT_DATA_NAME_SHORTENED)) {
			size_t n = MIN((size_t)field - 1U, size - 1U);

			memcpy(name, &eir[i + 2U], n);
			name[n] = '\0';
			if (type == BT_DATA_NAME_COMPLETE) {
				return;
			}
		}
		i += 1U + field;
	}
}

/* Lock held */
static struct btui_device *find_device(const bt_addr_t *addr)
{
	for (size_t i = 0; i < device_count; i++) {
		if (bt_addr_eq(&devices[i].addr, addr)) {
			return &devices[i];
		}
	}

	return NULL;
}

/* Lock held */
static void peer_name(const bt_addr_t *addr, char *name, size_t len)
{
	const struct btui_device *d = find_device(addr);

	if ((d != NULL) && (d->name[0] != '\0')) {
		snprintf(name, len, "%s", d->name);
	} else {
		bt_addr_to_str(addr, name, len);
	}
}

/* Lock held */
static void update_device(const struct bt_br_discovery_result *r)
{
	struct btui_device *d = find_device(&r->addr);
	char name[BTUI_NAME_LEN];

	if (d == NULL) {
		if (device_count == ARRAY_SIZE(devices)) {
			return;
		}
		d = &devices[device_count++];
		memset(d, 0, sizeof(*d));
		bt_addr_copy(&d->addr, &r->addr);
	}

	d->rssi = r->rssi;
	d->cod = sys_get_le24(r->cod);
	eir_name(r->eir, sizeof(r->eir), name, sizeof(name));
	if (name[0] != '\0') {
		memcpy(d->name, name, sizeof(d->name));
	}
}

static void discovery_recv(const struct bt_br_discovery_result *result)
{
	k_mutex_lock(&lock, K_FOREVER);
	update_device(result);
	k_mutex_unlock(&lock);
	post(BTUI_EV_DEVICES, 0);
}

/* At the end of the inquiry, with the names the Host resolved */
static void discovery_timeout(const struct bt_br_discovery_result *r, size_t count)
{
	k_mutex_lock(&lock, K_FOREVER);
	for (size_t i = 0; i < count; i++) {
		update_device(&r[i]);
	}
	info.discovering = false;
	k_mutex_unlock(&lock);
	post(BTUI_EV_DEVICES, 0);
	post(BTUI_EV_DISCOVERY, 0);
}

static struct bt_br_discovery_cb discovery_cb = {
	.recv = discovery_recv,
	.timeout = discovery_timeout,
};

static bool is_br(struct bt_conn *conn, const bt_addr_t **dst)
{
	struct bt_conn_info ci;

	if ((bt_conn_get_info(conn, &ci) != 0) || (ci.type != BT_CONN_TYPE_BR)) {
		return false;
	}
	if (dst != NULL) {
		*dst = ci.br.dst;
	}

	return true;
}

/* Lock held */
static void auth_clear(void)
{
	if (auth_conn != NULL) {
		bt_conn_unref(auth_conn);
		auth_conn = NULL;
	}
	auth_kind = AUTH_NONE;
}

/* Lock held; drops the link of an outgoing pairing once it is done */
static void pair_done(struct bt_conn *conn, bool disconnect)
{
	if ((pair_conn == NULL) || (conn != pair_conn)) {
		return;
	}
	if (disconnect) {
		(void)bt_conn_disconnect(conn, BT_HCI_ERR_REMOTE_USER_TERM_CONN);
	}
	bt_conn_unref(pair_conn);
	pair_conn = NULL;
}

static void connected(struct bt_conn *conn, uint8_t err)
{
	bool secure = false;

	if (!is_br(conn, NULL)) {
		return;
	}

	k_mutex_lock(&lock, K_FOREVER);
	if (err != 0U) {
		if (conn == pair_conn) {
			pair_done(conn, false);
			k_mutex_unlock(&lock);
			post(BTUI_EV_PAIR_FAILED, BT_SECURITY_ERR_UNSPECIFIED);
			return;
		}
		k_mutex_unlock(&lock);
		return;
	}
	info.connections++;
	secure = (conn == pair_conn);
	k_mutex_unlock(&lock);

	post(BTUI_EV_CONN, 0);
	if (secure && (bt_conn_set_security(conn, BT_SECURITY_L2) != 0)) {
		k_mutex_lock(&lock, K_FOREVER);
		pair_done(conn, true);
		k_mutex_unlock(&lock);
		post(BTUI_EV_PAIR_FAILED, BT_SECURITY_ERR_UNSPECIFIED);
	}
}

static void disconnected(struct bt_conn *conn, uint8_t reason)
{
	bool cancelled = false;

	if (!is_br(conn, NULL)) {
		return;
	}

	k_mutex_lock(&lock, K_FOREVER);
	if (info.connections > 0U) {
		info.connections--;
	}
	pair_done(conn, false);
	if (conn == auth_conn) {
		auth_clear();
		cancelled = true;
	}
	k_mutex_unlock(&lock);

	post(BTUI_EV_CONN, 0);
	if (cancelled) {
		post(BTUI_EV_CANCEL, 0);
	}
}

/*
 * An outgoing pairing ends once the link is authenticated and encrypted:
 * pairing_complete comes with Simple Pairing Complete, before the link key
 * and the authentication result, and dropping the link there fails it.
 */
static void security_changed(struct bt_conn *conn, bt_security_t level,
			     enum bt_security_err err)
{
	bool ours;

	ARG_UNUSED(level);

	if (!is_br(conn, NULL)) {
		return;
	}

	k_mutex_lock(&lock, K_FOREVER);
	ours = (conn == pair_conn);
	pair_done(conn, true);
	k_mutex_unlock(&lock);

	post(BTUI_EV_BONDS, 0);
	if (ours && (err != BT_SECURITY_ERR_SUCCESS)) {
		post(BTUI_EV_PAIR_FAILED, err);
	}
}

BT_CONN_CB_DEFINE(btui_conn_cb) = {
	.connected = connected,
	.disconnected = disconnected,
	.security_changed = security_changed,
};

static void auth_request(struct bt_conn *conn, enum auth_kind kind, enum btui_event ev,
			 int32_t value)
{
	k_mutex_lock(&lock, K_FOREVER);
	auth_clear();
	auth_conn = bt_conn_ref(conn);
	auth_kind = kind;
	k_mutex_unlock(&lock);
	post(ev, value);
}

static void passkey_display(struct bt_conn *conn, unsigned int passkey)
{
	auth_request(conn, AUTH_DISPLAY, BTUI_EV_DISPLAY, (int32_t)passkey);
}

static void passkey_confirm(struct bt_conn *conn, unsigned int passkey)
{
	auth_request(conn, AUTH_PASSKEY_CONFIRM, BTUI_EV_CONFIRM, (int32_t)passkey);
}

static void pairing_confirm(struct bt_conn *conn)
{
	auth_request(conn, AUTH_PAIRING_CONFIRM, BTUI_EV_CONFIRM, -1);
}

static void auth_cancel(struct bt_conn *conn)
{
	k_mutex_lock(&lock, K_FOREVER);
	if (conn == auth_conn) {
		auth_clear();
	}
	k_mutex_unlock(&lock);
	post(BTUI_EV_CANCEL, 0);
}

/* Display and yes/no make the phone DisplayYesNo */
static const struct bt_conn_auth_cb auth_cb = {
	.passkey_display = passkey_display,
	.passkey_confirm = passkey_confirm,
	.pairing_confirm = pairing_confirm,
	.cancel = auth_cancel,
};

/* A failed outgoing pairing leaves the link without a use */
static void pairing_end(struct bt_conn *conn, bool failed)
{
	k_mutex_lock(&lock, K_FOREVER);
	if (conn == auth_conn) {
		auth_clear();
	}
	if (failed) {
		pair_done(conn, true);
	}
	k_mutex_unlock(&lock);
}

static void pairing_complete(struct bt_conn *conn, bool bonded)
{
	if (!is_br(conn, NULL)) {
		return;
	}
	pairing_end(conn, false);
	post(BTUI_EV_PAIRED, bonded ? 1 : 0);
	post(BTUI_EV_BONDS, 0);
}

static void pairing_failed(struct bt_conn *conn, enum bt_security_err reason)
{
	if (!is_br(conn, NULL)) {
		return;
	}
	pairing_end(conn, true);
	post(BTUI_EV_PAIR_FAILED, reason);
}

static void bond_deleted(uint8_t id, const bt_addr_le_t *peer)
{
	ARG_UNUSED(id);
	ARG_UNUSED(peer);

	post(BTUI_EV_BONDS, 0);
}

static struct bt_conn_auth_info_cb auth_info_cb = {
	.pairing_complete = pairing_complete,
	.pairing_failed = pairing_failed,
	.bond_deleted = bond_deleted,
};

/*
 * Inquiring devices take the name from the Extended Inquiry Response, which
 * the Host leaves to the application, so it is rewritten with every name.
 */
static int write_eir(const char *name)
{
	const struct bt_data eir[] = {
		BT_DATA(BT_DATA_NAME_COMPLETE, name, strlen(name)),
	};
	int err = bt_br_write_eir(eir, ARRAY_SIZE(eir), true);

	if (err != 0) {
		LOG_ERR("EIR write failed (%d)", err);
	}

	return err;
}

static void ready(int err)
{
	static bool registered;
	bt_addr_le_t addr;
	size_t count = 1;

	if ((err == 0) && !registered) {
		bt_br_discovery_cb_register(&discovery_cb);
		(void)bt_conn_auth_cb_register(&auth_cb);
		(void)bt_conn_auth_info_cb_register(&auth_info_cb);
		registered = true;
	}

	k_mutex_lock(&lock, K_FOREVER);
	info.err = err;
	info.state = (err == 0) ? BTUI_ON : BTUI_FAILED;
	if (err == 0) {
		bt_id_get(&addr, &count);
		if (count > 0U) {
			bt_addr_copy(&info.addr, &addr.a);
		}
		snprintf(info.name, sizeof(info.name), "%s", bt_get_name());
	}
	k_mutex_unlock(&lock);

	if (err != 0) {
		LOG_ERR("Bluetooth init failed (%d)", err);
	} else {
		(void)write_eir(bt_get_name());
		/* Reachable by paired devices, but not discoverable, until asked */
		(void)btui_set_connectable(true);
	}
	post(BTUI_EV_STATE, err);
}

/*
 * The controller has no address of its own, only a placeholder from its
 * firmware, so derive one from the device ID (the OMAP die ID). The ID is
 * folded into the six octets of a unicast address that is marked as locally
 * administered, since it comes from no IEEE-assigned block, and kept out of
 * the LAPs reserved for inquiry access codes. The Host forgets identities in
 * bt_disable(), so this runs before every enable.
 */
static void create_identity(void)
{
	bt_addr_le_t addr = {.type = BT_ADDR_LE_PUBLIC};
	uint8_t id[16];
	ssize_t len;
	uint32_t lap;
	int err;

	len = hwinfo_get_device_id(id, sizeof(id));
	if (len <= 0) {
		LOG_WRN("no device ID (%d), the controller keeps its address", (int)len);
		return;
	}

	for (ssize_t i = 0; i < len; i++) {
		addr.a.val[i % sizeof(addr.a.val)] ^= id[i];
	}

	/* The most significant octet is the last one */
	addr.a.val[5] = (uint8_t)((addr.a.val[5] & ~BIT(0)) | BIT(1));

	lap = sys_get_le24(addr.a.val);
	if ((lap >= 0x9E8B00U) && (lap <= 0x9E8B3FU)) {
		addr.a.val[2] ^= BIT(0);
	}

	err = bt_id_create(&addr, NULL);
	if ((err < 0) && (err != -EALREADY)) {
		LOG_WRN("public identity not created (%d)", err);
	}
}

int btui_enable(void)
{
	int err;

	k_mutex_lock(&lock, K_FOREVER);
	if ((info.state == BTUI_ON) || (info.state == BTUI_STARTING)) {
		k_mutex_unlock(&lock);
		return -EALREADY;
	}
	info.state = BTUI_STARTING;
	k_mutex_unlock(&lock);

	create_identity();
	err = bt_enable(ready);
	if (err != 0) {
		k_mutex_lock(&lock, K_FOREVER);
		info.state = BTUI_FAILED;
		info.err = err;
		k_mutex_unlock(&lock);
	}
	post(BTUI_EV_STATE, err);

	return err;
}

int btui_disable(void)
{
	int err;

	if (info.discovering) {
		(void)bt_br_discovery_stop();
	}

	err = bt_disable();
	if (err != 0) {
		LOG_ERR("Bluetooth disable failed (%d)", err);
		return err;
	}

	k_mutex_lock(&lock, K_FOREVER);
	info.state = BTUI_OFF;
	info.discoverable = false;
	info.connectable = false;
	info.discovering = false;
	info.connections = 0;
	auth_clear();
	if (pair_conn != NULL) {
		bt_conn_unref(pair_conn);
		pair_conn = NULL;
	}
	k_mutex_unlock(&lock);
	post(BTUI_EV_STATE, 0);

	return 0;
}

void btui_get_info(struct btui_info *out)
{
	k_mutex_lock(&lock, K_FOREVER);
	*out = info;
	k_mutex_unlock(&lock);
}

int btui_set_connectable(bool on)
{
	int err = bt_br_set_connectable(on, NULL);

	if ((err != 0) && (err != -EALREADY)) {
		LOG_ERR("connectable %d failed (%d)", on, err);
		return err;
	}

	k_mutex_lock(&lock, K_FOREVER);
	info.connectable = on;
	if (!on) {
		/* Inquiry scan goes with page scan */
		info.discoverable = false;
	}
	k_mutex_unlock(&lock);
	post(BTUI_EV_STATE, 0);

	return 0;
}

int btui_set_discoverable(bool on)
{
	int err;

	if (on && !info.connectable) {
		err = btui_set_connectable(true);
		if (err != 0) {
			return err;
		}
	}

	err = bt_br_set_discoverable(on, false);
	if ((err != 0) && (err != -EALREADY)) {
		LOG_ERR("discoverable %d failed (%d)", on, err);
		return err;
	}

	k_mutex_lock(&lock, K_FOREVER);
	info.discoverable = on;
	k_mutex_unlock(&lock);
	post(BTUI_EV_STATE, 0);

	return 0;
}

int btui_set_name(const char *name)
{
	int err = bt_set_name(name);

	if (err != 0) {
		LOG_ERR("set name failed (%d)", err);
		return err;
	}

	err = write_eir(name);
	if (err != 0) {
		return err;
	}

	k_mutex_lock(&lock, K_FOREVER);
	snprintf(info.name, sizeof(info.name), "%s", bt_get_name());
	k_mutex_unlock(&lock);
	post(BTUI_EV_STATE, 0);

	return 0;
}

int btui_discover(void)
{
	static const struct bt_br_discovery_param param = {
		.length = DISCOVERY_LENGTH,
		.limited = false,
	};
	int err;

	k_mutex_lock(&lock, K_FOREVER);
	device_count = 0;
	k_mutex_unlock(&lock);

	err = bt_br_discovery_start(&param, results, ARRAY_SIZE(results));
	if (err != 0) {
		LOG_ERR("discovery failed (%d)", err);
		return err;
	}

	k_mutex_lock(&lock, K_FOREVER);
	info.discovering = true;
	k_mutex_unlock(&lock);
	post(BTUI_EV_DEVICES, 0);
	post(BTUI_EV_DISCOVERY, 1);

	return 0;
}

struct bond_list {
	struct btui_device *out;
	size_t max;
	size_t count;
};

static void add_bond(const struct bt_br_bond_info *bi, void *user_data)
{
	struct bond_list *list = user_data;
	struct btui_device *d;

	if (list->count == list->max) {
		return;
	}

	d = &list->out[list->count++];
	memset(d, 0, sizeof(*d));
	bt_addr_copy(&d->addr, &bi->addr);
	d->paired = true;
}

size_t btui_get_bonds(struct btui_device *bonds, size_t max)
{
	struct bond_list list = {.out = bonds, .max = max};

	if (info.state != BTUI_ON) {
		return 0;
	}

	bt_br_foreach_bond(add_bond, &list);

	k_mutex_lock(&lock, K_FOREVER);
	for (size_t i = 0; i < list.count; i++) {
		const struct btui_device *d = find_device(&bonds[i].addr);

		if (d != NULL) {
			memcpy(bonds[i].name, d->name, sizeof(bonds[i].name));
			bonds[i].cod = d->cod;
		}
	}
	k_mutex_unlock(&lock);

	return list.count;
}

size_t btui_get_devices(struct btui_device *out, size_t max)
{
	struct btui_device bonds[BTUI_MAX_BONDS];
	size_t bond_count = btui_get_bonds(bonds, ARRAY_SIZE(bonds));
	size_t n;

	k_mutex_lock(&lock, K_FOREVER);
	n = MIN(device_count, max);
	memcpy(out, devices, n * sizeof(*out));
	k_mutex_unlock(&lock);

	for (size_t i = 0; i < n; i++) {
		out[i].paired = false;
		for (size_t j = 0; j < bond_count; j++) {
			if (bt_addr_eq(&out[i].addr, &bonds[j].addr)) {
				out[i].paired = true;
			}
		}
	}

	return n;
}

int btui_pair(const bt_addr_t *addr)
{
	struct bt_conn *conn;
	int err;

	if (info.discovering) {
		(void)bt_br_discovery_stop();
		k_mutex_lock(&lock, K_FOREVER);
		info.discovering = false;
		k_mutex_unlock(&lock);
		post(BTUI_EV_DISCOVERY, 0);
	}

	conn = bt_conn_lookup_addr_br(addr);
	if (conn != NULL) {
		/* Already connected: just raise the security */
		err = bt_conn_set_security(conn, BT_SECURITY_L2);
		bt_conn_unref(conn);
		return err;
	}

	k_mutex_lock(&lock, K_FOREVER);
	if (pair_conn != NULL) {
		k_mutex_unlock(&lock);
		return -EBUSY;
	}
	conn = bt_conn_create_br(addr, BT_BR_CONN_PARAM_DEFAULT);
	if (conn == NULL) {
		k_mutex_unlock(&lock);
		return -EIO;
	}
	pair_conn = conn;
	k_mutex_unlock(&lock);

	return 0;
}

int btui_forget(const bt_addr_t *addr)
{
	int err = bt_br_unpair(addr);

	if (err != 0) {
		LOG_ERR("unpair failed (%d)", err);
		return err;
	}
	post(BTUI_EV_BONDS, 0);
	post(BTUI_EV_DEVICES, 0);

	return 0;
}

void btui_pending_peer(char *name, size_t len)
{
	const bt_addr_t *dst;

	k_mutex_lock(&lock, K_FOREVER);
	if ((auth_conn != NULL) && is_br(auth_conn, &dst)) {
		peer_name(dst, name, len);
	} else {
		snprintf(name, len, "a device");
	}
	k_mutex_unlock(&lock);
}

void btui_respond(bool accept)
{
	struct bt_conn *conn;
	enum auth_kind kind;

	k_mutex_lock(&lock, K_FOREVER);
	kind = auth_kind;
	if ((kind == AUTH_DISPLAY) && accept) {
		/* Dismissed: the pairing goes on until the peer finishes it */
		k_mutex_unlock(&lock);
		return;
	}
	conn = auth_conn;
	auth_conn = NULL;
	auth_kind = AUTH_NONE;
	k_mutex_unlock(&lock);

	if (conn == NULL) {
		return;
	}

	if (!accept) {
		(void)bt_conn_auth_cancel(conn);
	} else if (kind == AUTH_PASSKEY_CONFIRM) {
		(void)bt_conn_auth_passkey_confirm(conn);
	} else {
		(void)bt_conn_auth_pairing_confirm(conn);
	}
	bt_conn_unref(conn);
}
```

## src/btui.h
```c
/*
 * SPDX-FileCopyrightText: Copyright (c) 2026 Silicon Laboratories Inc.
 * SPDX-License-Identifier: Apache-2.0
 */

/* N900 phone demo: Bluetooth BR/EDR state for the UI */
#ifndef BTUI_H_
#define BTUI_H_

#include <stdbool.h>
#include <stddef.h>
#include <stdint.h>

#include <zephyr/bluetooth/addr.h>

#define BTUI_MAX_DEVICES 16
#define BTUI_MAX_BONDS   8
#define BTUI_NAME_LEN    32

enum btui_state {
	BTUI_OFF,
	BTUI_STARTING,
	BTUI_ON,
	BTUI_FAILED,
};

/* Codes of PEV_BT events, posted with phone_post() from Bluetooth threads */
enum btui_event {
	BTUI_EV_STATE,        /* enabled, disabled or failed; value: error */
	BTUI_EV_DEVICES,      /* the discovered devices changed */
	BTUI_EV_DISCOVERY,    /* discovery started (value 1) or ended (value 0) */
	BTUI_EV_BONDS,        /* the paired devices changed */
	BTUI_EV_CONN,         /* the number of connections changed */
	BTUI_EV_CONFIRM,      /* pairing needs a yes/no; value: passkey, or -1 */
	BTUI_EV_DISPLAY,      /* show a passkey to type on the peer; value: passkey */
	BTUI_EV_CANCEL,       /* the pending pairing request went away */
	BTUI_EV_PAIRED,       /* pairing completed; value: bonded */
	BTUI_EV_PAIR_FAILED,  /* value: enum bt_security_err */
};

struct btui_info {
	enum btui_state state;
	int err;
	bt_addr_t addr;
	char name[BTUI_NAME_LEN];
	bool discoverable;
	bool connectable;
	bool discovering;
	uint8_t connections;
};

struct btui_device {
	bt_addr_t addr;
	char name[BTUI_NAME_LEN];
	uint32_t cod;
	int8_t rssi;
	bool paired;
};

/* All functions below are for the LVGL thread */
int btui_enable(void);
int btui_disable(void);
void btui_get_info(struct btui_info *info);

int btui_set_connectable(bool on);
int btui_set_discoverable(bool on);
int btui_set_name(const char *name);

int btui_discover(void);
size_t btui_get_devices(struct btui_device *devices, size_t max);
size_t btui_get_bonds(struct btui_device *bonds, size_t max);

int btui_pair(const bt_addr_t *addr);
int btui_forget(const bt_addr_t *addr);

/* Name of the peer of the pending pairing request, for dialogs */
void btui_pending_peer(char *name, size_t len);
/* Answers the pending CONFIRM, or cancels a pending DISPLAY when accept is false */
void btui_respond(bool accept);

#endif /* BTUI_H_ */
```

## src/phone.h
```c
/* N900 phone demo: shared definitions */
#ifndef PHONE_H_
#define PHONE_H_

#include <stdbool.h>
#include <stdint.h>

enum phone_event_type {
	PEV_KEY,    /* code, value: key press/release */
	PEV_SWITCH, /* code, value: INPUT_SW_* */
	PEV_TAP,    /* accelerometer tap */
	PEV_USB,    /* value: VBUS present */
	PEV_BT,     /* code: enum btui_event, value: as the code describes */
	PEV_TERM,   /* the terminal has new output */
};

struct phone_event {
	uint8_t type;
	uint16_t code;
	int32_t value;
};

/* Latest sensor readings, refreshed by the sensor threads */
struct phone_sensors {
	bool gauge_ok;
	int soc;           /* % */
	int mv;            /* battery voltage */
	int ma;            /* battery current, positive while charging */
	int temp_dc;       /* deci-degrees Celsius */
	int charger;       /* enum charger_status */
	bool vbus;
	bool light_ok;
	int lux;
	bool accel_ok;
	int ax, ay, az;    /* centi m/s^2 */
};

void phone_post(uint8_t type, uint16_t code, int32_t value);
void phone_sensors_get(struct phone_sensors *out);

/* Hardware control, LVGL thread only */
void hw_init(void);
void hw_screen(bool on, uint8_t brightness);
void hw_kbd_backlight(uint8_t pct);
void hw_status_led(uint8_t r, uint8_t g, uint8_t b);
void hw_torch(bool on);
void hw_vibrate(uint32_t ms);

/* UI, LVGL thread only */
void ui_init(void);
void ui_event(const struct phone_event *e);

#endif
```

## src/shell_term.c
```c
/*
 * SPDX-FileCopyrightText: Copyright (c) 2026 Silicon Laboratories Inc.
 * SPDX-License-Identifier: Apache-2.0
 */

/*
 * Shell backend of the phone demo's terminal: the shell writes into the
 * terminal grid, which takes everything at once, and reads what the UI
 * queues from the keyboard. Log messages come out on it as well.
 */
#include <zephyr/init.h>
#include <zephyr/kernel.h>
#include <zephyr/logging/log.h>
#include <zephyr/shell/shell.h>
#include <zephyr/sys/atomic.h>
#include <zephyr/sys/ring_buffer.h>

#include "phone.h"
#include "term.h"

#define LOG_QUEUE_SIZE 16
#define LOG_TIMEOUT_MS 100

struct term_transport {
	shell_transport_handler_t handler;
	void *context;
};

static struct term_transport term_transport;
static struct k_spinlock rx_lock;
static atomic_t posted;
RING_BUF_DECLARE(rx_ring, 64);

static int transport_init(const struct shell_transport *transport, const void *config,
			  shell_transport_handler_t evt_handler, void *context)
{
	struct term_transport *t = transport->ctx;

	ARG_UNUSED(config);

	t->handler = evt_handler;
	t->context = context;

	return 0;
}

static int transport_uninit(const struct shell_transport *transport)
{
	ARG_UNUSED(transport);

	return 0;
}

static int transport_enable(const struct shell_transport *transport, bool blocking_tx)
{
	ARG_UNUSED(transport);
	ARG_UNUSED(blocking_tx);

	return 0;
}

static int transport_write(const struct shell_transport *transport, const void *data,
			   size_t length, size_t *cnt)
{
	struct term_transport *t = transport->ctx;

	term_write(data, length);
	*cnt = length;

	if (!atomic_set(&posted, 1)) {
		phone_post(PEV_TERM, 0, 0);
	}

	t->handler(SHELL_TRANSPORT_EVT_TX_RDY, t->context);

	return 0;
}

static int transport_read(const struct shell_transport *transport, void *data, size_t length,
			  size_t *cnt)
{
	k_spinlock_key_t key = k_spin_lock(&rx_lock);

	ARG_UNUSED(transport);

	*cnt = ring_buf_get(&rx_ring, data, length);
	k_spin_unlock(&rx_lock, key);

	return 0;
}

static const struct shell_transport_api transport_api = {
	.init = transport_init,
	.uninit = transport_uninit,
	.enable = transport_enable,
	.write = transport_write,
	.read = transport_read,
};

static struct shell_transport transport = {
	.api = &transport_api,
	.ctx = &term_transport,
};

SHELL_DEFINE(shell_term, "n900:~$ ", &transport, LOG_QUEUE_SIZE, LOG_TIMEOUT_MS,
	     SHELL_FLAG_OLF_CRLF);

void term_shell_input(const char *data, size_t len)
{
	k_spinlock_key_t key = k_spin_lock(&rx_lock);
	uint32_t put = ring_buf_put(&rx_ring, data, len);

	k_spin_unlock(&rx_lock, key);

	if ((put > 0U) && (term_transport.handler != NULL)) {
		term_transport.handler(SHELL_TRANSPORT_EVT_RX_RDY, term_transport.context);
	}
}

void term_shell_ack(void)
{
	atomic_clear(&posted);
}

static int shell_term_init(void)
{
	static const struct shell_backend_config_flags cfg_flags =
		SHELL_DEFAULT_BACKEND_CONFIG_FLAGS;

	/* The answers to the shell's queries, such as the cursor position */
	term_init(term_shell_input);

	return shell_init(&shell_term, NULL, cfg_flags, true, LOG_LEVEL_INF);
}

SYS_INIT(shell_term_init, APPLICATION, 0);
```

## src/term.c
```c
/*
 * SPDX-FileCopyrightText: Copyright (c) 2026 Silicon Laboratories Inc.
 * SPDX-License-Identifier: Apache-2.0
 */

/*
 * The VT100 subset of the Zephyr shell: CR, LF, BS and TAB, cursor movement
 * (CUU, CUD, CUF, CUB, CUP, CHA, VPA), erasing (ED, EL), SGR foreground
 * colours, saving and restoring the cursor, the autowrap mode and the cursor
 * position report the shell's resize command asks for. Like a VT100, a
 * character written to the last column leaves the cursor there and the next
 * one wraps, as the shell moves to a new line itself when a command line
 * fills one.
 */
#include <stdio.h>
#include <string.h>

#include <zephyr/kernel.h>
#include <zephyr/sys/atomic.h>
#include <zephyr/sys/util.h>

#include "term.h"

#define MAX_PARAMS 4
#define MAX_PARAM  9999U

enum parse_state {
	PARSE_TEXT,
	PARSE_ESC,
	PARSE_CSI,
	/* The character set designator after ESC ( or ESC ) */
	PARSE_SKIP,
	/* The continuation bytes of a UTF-8 sequence */
	PARSE_UTF8,
};

static K_MUTEX_DEFINE(lock);
static atomic_t changed;
static term_reply_t reply_cb;

static struct term_cell cells[TERM_LINES][TERM_COLS];
static bool dirty[TERM_LINES];
static uint32_t end;

/* On the screen; col is TERM_COLS while a wrap is pending */
static uint16_t row;
static uint16_t col;
static uint8_t color;
static uint16_t saved_row;
static uint16_t saved_col;
static uint8_t saved_color;
static bool autowrap;

static enum parse_state state;
static uint16_t params[MAX_PARAMS];
static uint8_t param_count;
static bool csi_private;
static uint8_t utf8_left;

static struct term_cell *line_cells(uint32_t line)
{
	return cells[line % TERM_LINES];
}

static uint32_t screen_line(uint16_t r)
{
	return end - TERM_ROWS + r;
}

static void erase(uint32_t line, uint16_t from, uint16_t to)
{
	struct term_cell *c = line_cells(line);

	for (uint16_t i = from; i < MIN(to, TERM_COLS); i++) {
		c[i].c = ' ';
		c[i].color = TERM_COLOR_DEFAULT;
	}
	dirty[line % TERM_LINES] = true;
}

static void erase_screen(uint16_t from_row, uint16_t to_row)
{
	for (uint16_t r = from_row; r < to_row; r++) {
		erase(screen_line(r), 0, TERM_COLS);
	}
}

static void line_feed(void)
{
	if ((row + 1U) < TERM_ROWS) {
		row++;
		return;
	}

	/* The new line takes the place of the oldest one */
	end++;
	erase(end - 1U, 0, TERM_COLS);
}

/* A pending wrap ends when the cursor moves */
static void settle(void)
{
	if (col >= TERM_COLS) {
		col = TERM_COLS - 1U;
	}
}

static void put(char ch)
{
	struct term_cell *c;

	if (col >= TERM_COLS) {
		if (!autowrap) {
			col = TERM_COLS - 1U;
		} else {
			col = 0U;
			line_feed();
		}
	}

	c = &line_cells(screen_line(row))[col];
	c->c = ch;
	c->color = color;
	dirty[screen_line(row) % TERM_LINES] = true;
	col++;
}

static void control(char ch)
{
	switch (ch) {
	case '\r':
		col = 0U;
		break;
	case '\n':
	case '\v':
	case '\f':
		settle();
		line_feed();
		break;
	case '\b':
		settle();
		if (col > 0U) {
			col--;
		}
		break;
	case '\t':
		settle();
		col = MIN(ROUND_DOWN(col + 8U, 8U), TERM_COLS - 1U);
		break;
	case '\x1b':
		state = PARSE_ESC;
		break;
	default:
		/* BEL and the rest have no effect */
		break;
	}
}

static uint16_t param(uint8_t i, uint16_t def)
{
	return ((i < param_count) && (params[i] != 0U)) ? params[i] : def;
}

static void reply(const char *fmt, int a, int b)
{
	char buf[16];
	int len = snprintf(buf, sizeof(buf), fmt, a, b);

	if ((reply_cb != NULL) && (len > 0)) {
		reply_cb(buf, MIN((size_t)len, sizeof(buf) - 1U));
	}
}

static void sgr(void)
{
	if (param_count == 0U) {
		color = TERM_COLOR_DEFAULT;
		return;
	}

	for (uint8_t i = 0U; i < param_count; i++) {
		uint16_t p = params[i];

		if (p == 0U || p == 39U) {
			color = TERM_COLOR_DEFAULT;
		} else if (IN_RANGE(p, 30U, 37U)) {
			color = (uint8_t)(1U + p - 30U);
		} else if (IN_RANGE(p, 90U, 97U)) {
			color = (uint8_t)(1U + p - 90U);
		} else {
			/* Bold, underline and backgrounds are not shown */
		}
	}
}

static void csi(char final)
{
	uint16_t n = param(0, 1);

	if (final != 'm' && final != 'n' && final != 'h' && final != 'l') {
		settle();
	}

	switch (final) {
	case 'A':
		row = (row > n) ? (row - n) : 0U;
		break;
	case 'B':
		row = MIN(row + n, TERM_ROWS - 1U);
		break;
	case 'C':
		col = MIN(col + n, TERM_COLS - 1U);
		break;
	case 'D':
		col = (col > n) ? (col - n) : 0U;
		break;
	case 'G':
		col = MIN(n, TERM_COLS) - 1U;
		break;
	case 'd':
		row = MIN(n, TERM_ROWS) - 1U;
		break;
	case 'H':
	case 'f':
		row = MIN(n, TERM_ROWS) - 1U;
		col = MIN(param(1, 1), TERM_COLS) - 1U;
		break;
	case 'J':
		switch (param(0, 0)) {
		case 0:
			erase(screen_line(row), col, TERM_COLS);
			erase_screen(row + 1U, TERM_ROWS);
			break;
		case 1:
			erase_screen(0U, row);
			erase(screen_line(row), 0U, col + 1U);
			break;
		default:
			erase_screen(0U, TERM_ROWS);
			break;
		}
		break;
	case 'K':
		switch (param(0, 0)) {
		case 0:
			erase(screen_line(row), col, TERM_COLS);
			break;
		case 1:
			erase(screen_line(row), 0U, col + 1U);
			break;
		default:
			erase(screen_line(row), 0U, TERM_COLS);
			break;
		}
		break;
	case 'm':
		sgr();
		break;
	case 'n':
		if (param(0, 0) == 6U) {
			reply("\x1b[%d;%dR", row + 1, MIN(col, TERM_COLS - 1U) + 1);
		} else if (param(0, 0) == 5U) {
			reply("\x1b[0n", 0, 0);
		}
		break;
	case 'h':
	case 'l':
		if (csi_private && (param(0, 0) == 7U)) {
			autowrap = (final == 'h');
		}
		break;
	default:
		break;
	}
}

static void escape(char ch)
{
	state = PARSE_TEXT;

	switch (ch) {
	case '[':
		state = PARSE_CSI;
		param_count = 0U;
		csi_private = false;
		memset(params, 0, sizeof(params));
		break;
	case '(':
	case ')':
		state = PARSE_SKIP;
		break;
	case '7':
		saved_row = row;
		saved_col = col;
		saved_color = color;
		break;
	case '8':
		row = saved_row;
		col = saved_col;
		color = saved_color;
		break;
	case 'D':
		settle();
		line_feed();
		break;
	case 'E':
		col = 0U;
		line_feed();
		break;
	case 'M':
		settle();
		if (row > 0U) {
			row--;
		}
		break;
	case 'c':
		color = TERM_COLOR_DEFAULT;
		autowrap = true;
		row = 0U;
		col = 0U;
		erase_screen(0U, TERM_ROWS);
		break;
	default:
		break;
	}
}

static void csi_byte(char ch)
{
	if ((ch >= '0') && (ch <= '9')) {
		if (param_count == 0U) {
			param_count = 1U;
		}
		if (param_count <= MAX_PARAMS) {
			uint16_t *p = &params[param_count - 1U];
			uint32_t v = (uint32_t)*p * 10U + (uint32_t)(ch - '0');

			*p = (uint16_t)MIN(v, MAX_PARAM);
		}
	} else if (ch == ';') {
		if (param_count == 0U) {
			param_count = 1U;
		}
		if (param_count < MAX_PARAMS) {
			param_count++;
		}
	} else if (ch == '?') {
		csi_private = true;
	} else if ((ch >= 0x40) && (ch <= 0x7E)) {
		state = PARSE_TEXT;
		param_count = MIN(param_count, MAX_PARAMS);
		csi(ch);
	} else if ((uint8_t)ch < 0x20U) {
		control(ch);
	} else {
		/* Intermediate bytes are not used */
	}
}

static void feed(char ch)
{
	uint8_t b = (uint8_t)ch;

	switch (state) {
	case PARSE_ESC:
		escape(ch);
		return;
	case PARSE_CSI:
		csi_byte(ch);
		return;
	case PARSE_SKIP:
		state = PARSE_TEXT;
		return;
	case PARSE_UTF8:
		if ((b & 0xC0U) == 0x80U) {
			if (--utf8_left == 0U) {
				state = PARSE_TEXT;
			}
			return;
		}
		state = PARSE_TEXT;
		break;
	default:
		break;
	}

	if (b < 0x20U) {
		control(ch);
	} else if (b < 0x7FU) {
		put(ch);
	} else if (b >= 0xC0U) {
		/* The font is ASCII: one '?' for each other character */
		put('?');
		utf8_left = (b >= 0xF0U) ? 3U : ((b >= 0xE0U) ? 2U : 1U);
		state = PARSE_UTF8;
	} else {
		/* DEL and stray continuation bytes */
	}
}

void term_init(term_reply_t reply_fn)
{
	k_mutex_lock(&lock, K_FOREVER);
	reply_cb = reply_fn;
	end = TERM_ROWS;
	row = 0U;
	col = 0U;
	color = TERM_COLOR_DEFAULT;
	autowrap = true;
	state = PARSE_TEXT;
	for (uint32_t line = 0U; line < TERM_LINES; line++) {
		erase(line, 0U, TERM_COLS);
	}
	k_mutex_unlock(&lock);
	atomic_set(&changed, 1);
}

void term_write(const char *data, size_t len)
{
	k_mutex_lock(&lock, K_FOREVER);
	for (size_t i = 0U; i < len; i++) {
		feed(data[i]);
	}
	k_mutex_unlock(&lock);
	atomic_set(&changed, 1);
}

bool term_take_changed(void)
{
	return atomic_clear(&changed) != 0;
}

void term_lock(struct term_view *view)
{
	k_mutex_lock(&lock, K_FOREVER);
	view->first = (end > TERM_LINES) ? (end - TERM_LINES) : 0U;
	view->end = end;
	view->cursor_line = screen_line(row);
	view->cursor_col = MIN(col, TERM_COLS - 1U);
}

void term_unlock(void)
{
	k_mutex_unlock(&lock);
}

const struct term_cell *term_line(uint32_t line)
{
	return line_cells(line);
}

bool term_take_dirty(uint32_t line)
{
	bool was = dirty[line % TERM_LINES];

	dirty[line % TERM_LINES] = false;
	return was;
}
```

## src/term.h
```c
/*
 * SPDX-FileCopyrightText: Copyright (c) 2026 Silicon Laboratories Inc.
 * SPDX-License-Identifier: Apache-2.0
 */

/*
 * Character grid of the phone demo's terminal: a VT100 subset, enough for
 * the Zephyr shell. Lines are numbered as they scroll in; the screen is the
 * last TERM_ROWS of them and up to TERM_LINES are kept, the screen included.
 * Writes may come from any thread; readers take the lock.
 */
#ifndef TERM_H_
#define TERM_H_

#include <stdbool.h>
#include <stddef.h>
#include <stdint.h>

#define TERM_COLS  88
#define TERM_ROWS  23
#define TERM_LINES 200

/* Colour of a cell: the default one, or 1 + an ANSI colour 0..7 */
#define TERM_COLOR_DEFAULT 0U

struct term_cell {
	char c;
	uint8_t color;
};

struct term_view {
	/* Oldest line kept, and one past the newest */
	uint32_t first;
	uint32_t end;
	/* Line and column of the cursor */
	uint32_t cursor_line;
	uint16_t cursor_col;
};

/* Sends the terminal's answers to queries, such as the cursor position */
typedef void (*term_reply_t)(const char *data, size_t len);

void term_init(term_reply_t reply);
void term_write(const char *data, size_t len);

/* True once after every change */
bool term_take_changed(void);

/* The rest is called with the lock held */
void term_lock(struct term_view *view);
void term_unlock(void);
const struct term_cell *term_line(uint32_t line);
bool term_take_dirty(uint32_t line);

/*
 * The shell on the terminal (shell_term.c): typed input for the shell, and
 * the acknowledgment of a PEV_TERM event, which is posted once until then.
 */
void term_shell_input(const char *data, size_t len);
void term_shell_ack(void);

#endif
```
