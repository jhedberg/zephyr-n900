## drivers/bluetooth/Kconfig.nokia_h4p
```kconfig
# SPDX-FileCopyrightText: Copyright (c) 2026 Silicon Laboratories Inc.
# SPDX-License-Identifier: Apache-2.0

config BT_NOKIA_H4P
	bool "Nokia H4+ HCI driver"
	default y
	depends on DT_HAS_NOKIA_H4P_BLUETOOTH_ENABLED
	select BT_UART
	select UART_LINE_CTRL
	select UART_NS16550_LINE_CTRL if UART_NS16550
	select GPIO
	select PINCTRL
	select BT_HCI_SET_PUBLIC_ADDR
	help
	  HCI driver for the Bluetooth controllers of Nokia phones that speak
	  Nokia's H4+ over a UART, such as the BCM2048 of the N900.

if BT_NOKIA_H4P

config BT_NOKIA_H4P_FIRMWARE
	string "Firmware script"
	help
	  Absolute path to the firmware script that is sent to the controller
	  before anything else, bcmfw.bin from Maemo for the BCM2048. The
	  BCM2048 does not work as a controller without it. The script may not
	  be redistributed, so it is not part of this repository.

config BT_NOKIA_H4P_RX_STACK_SIZE
	int "Receive thread stack size"
	default 1024

endif # BT_NOKIA_H4P
```

## drivers/wifi/wl1251/Kconfig
```kconfig
# SPDX-FileCopyrightText: Copyright (c) 2026 Silicon Laboratories Inc.
# SPDX-License-Identifier: Apache-2.0

config WIFI_WL1251
	bool "TI WL1251 802.11b/g controller"
	default y
	depends on DT_HAS_TI_WL1251_ENABLED
	depends on NETWORKING
	select SPI
	select GPIO
	select CRC
	select NET_L2_ETHERNET
	select NET_L2_WIFI_MGMT
	select WIFI_USE_NATIVE_NETWORKING
	help
	  Driver for the TI WL1251 Wi-Fi controller on SPI, as in the
	  Nokia N900. The chip is powered and its firmware loaded when the
	  network interface is brought up. It scans on its own; joining a
	  network takes wpa_supplicant (WIFI_NM_WPA_SUPPLICANT). Of the
	  security modes, WPA2 with CCMP is supported.

if WIFI_WL1251

config WIFI_WL1251_FIRMWARE
	string "Firmware image"
	help
	  Absolute path to the firmware that is loaded into the chip:
	  ti-connectivity/wl1251-fw.bin of linux-firmware, under TI's
	  license there. It is not part of this repository. Without it and
	  the calibration data the driver builds but cannot start the chip.

config WIFI_WL1251_NVS
	string "Calibration data"
	help
	  Absolute path to the calibration data (NVS) that is loaded into the
	  chip along with the firmware: ti-connectivity/wl1251-nvs.bin of
	  linux-firmware, which holds default values.

config WIFI_WL1251_MAX_BSS
	int "Networks kept from a scan"
	default 24
	range 1 64

config WIFI_WL1251_BSS_IES_SIZE
	int "Size of the information elements kept for each network"
	default 384
	range 64 1024
	help
	  What does not fit is cut off. The security settings of a network
	  are among its first elements.

config WIFI_WL1251_STACK_SIZE
	int "Stack size of the driver thread"
	default 2048

config WIFI_WL1251_THREAD_PRIO
	int "Cooperative priority of the driver thread"
	default 6

endif # WIFI_WL1251
```

## dts/bindings/bluetooth/nokia,h4p-bluetooth.yaml
```yaml
# SPDX-FileCopyrightText: Copyright (c) 2026 Silicon Laboratories Inc.
# SPDX-License-Identifier: Apache-2.0

description: |
  Bluetooth controller of a Nokia phone behind a UART, speaking Nokia's H4+:
  H4 with every frame padded to an even length, packets that negotiate the
  UART speed and check the link, and wakeup lines in both directions.

  The node is a child of its UART. The UART's current-speed is the speed
  negotiated with the controller, which starts at 120000 baud.

compatible: "nokia,h4p-bluetooth"

include: [bt-hci.yaml, pinctrl-device.yaml]

properties:
  bt-hci-name:
    default: "H4+"

  bt-hci-bus:
    default: "uart"

  reset-gpios:
    type: phandle-array
    required: true
    description: Reset line of the controller.

  bluetooth-wakeup-gpios:
    type: phandle-array
    required: true
    description: Line the host raises while it transmits, to wake the controller.

  host-wakeup-gpios:
    type: phandle-array
    required: true
    description: Line the controller raises while it has something to send.

  clocks:
    required: true
    description: |
      System clock of the controller, a fixed clock whose clock-frequency
      is given to the controller during negotiation.
```

## dts/bindings/wifi/ti,wl1251.yaml
```yaml
# SPDX-FileCopyrightText: Copyright (c) 2026 Silicon Laboratories Inc.
# SPDX-License-Identifier: Apache-2.0

description: |
  TI WL1251 802.11b/g controller on SPI.

  The chip speaks TI's WSPI in SPI mode 3 with 32-bit words, so the node
  needs spi-cpol and spi-cpha.

compatible: "ti,wl1251"

include: [spi-device.yaml, ethernet-controller.yaml]

properties:
  power-gpios:
    type: phandle-array
    required: true
    description: Enables the chip's power while active.

  irq-gpios:
    type: phandle-array
    required: true
    description: Interrupt line, with a rising edge for a new interrupt.
```

## west.yml
```yaml
# Copyright The Zephyr Project Contributors
# Copyright (c) 2026 Silicon Laboratories Inc.
# SPDX-License-Identifier: Apache-2.0

manifest:
  remotes:
    - name: nashif
      url-base: https://github.com/nashif

  projects:
    - name: zephyr
      remote: nashif
      # Upstream main plus the core changes the N900 needs
      revision: topic/n900/core
      import:
        name-allowlist:
          - cmsis # Cortex-A core headers
          - lvgl  # the phone demo UI
          # PSA crypto for the Bluetooth host
          - mbedtls
          - tf-psa-crypto
          - tf-psa-crypto-drivers
```
